## Kconfig
```kconfig
menu "Hana charging telemetry"

config HANA_CHARGE_STATUS
    bool "Enable Hana charging-state telemetry"
    default n
    help
      Enables charging-state detection and transport for Hana peripherals.

endmenu

config ZMK_DONGLE_DISPLAY_BASE_LAYER_COUNT
    int "Number of initial layers treated as base layers"
    default 2
    range 1 8
    help
      Number of initial keymap layers treated as base layers by the shared
      dongle display. Hana/Chocofi uses two; Sofle uses one.
```

## boards/shields/dongle_display_test_promicro_128x32/Kconfig.shield
```kconfig
config SHIELD_DONGLE_DISPLAY_TEST_PROMICRO_128X32
    def_bool $(shields_list_contains,dongle_display_test_promicro_128x32)
```

## boards/shields/dongle_display_test_xiao_128x32/Kconfig.shield
```kconfig
config SHIELD_DONGLE_DISPLAY_TEST_XIAO_128X32
    def_bool $(shields_list_contains,dongle_display_test_xiao_128x32)
```

## boards/shields/dongle_display_test_xiao_128x64/Kconfig.shield
```kconfig
config SHIELD_DONGLE_DISPLAY_TEST_XIAO_128X64
    def_bool $(shields_list_contains,dongle_display_test_xiao_128x64)
```

## config/west.yml
```yaml
manifest:
  remotes:
    - name: zmkfirmware
      url-base: https://github.com/zmkfirmware
    - name: englmaxi
      url-base: https://github.com/englmaxi
    - name: sukumar
      url-base: https://github.com/Sukumar002
  projects:
    - name: zmk
      remote: sukumar
      revision: 7f0adab5ed85d90919d8382c52867556c6269d05
      import: app/west.yml
    - name: zmk-config
      remote: englmaxi
      revision: main
  self:
    path: config
```
