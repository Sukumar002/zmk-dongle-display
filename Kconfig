## Kconfig
```kconfig
menu "Hana charging telemetry"

config HANA_CHARGE_STATUS
    bool "Enable Hana charging-state telemetry"
    default n
    help
      Enables charging-state detection and transport for Hana peripherals.

endmenu

config ZMK_DONGLE_DISPLAY_SIDE_BATTERY_TEXT
    bool "Show split battery levels with physical side labels"
    default n
    help
      Display split battery levels as L 00/R 00 using validated side IDs.
```
